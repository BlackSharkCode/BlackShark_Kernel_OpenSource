## drivers/blackshark/Kconfig
```kconfig
menu "zeusis linux device driver support"

#
# Hawkeye driver configuration
#
config HAWKEYE_BMS
        default y
        bool "Enable bug report for Hawkeye" if EXPERT
        depends on PRINTK
        help
           This operation anables monitor log mechanism for ZEUSIS private modules.

config HAWKEYE_PMS
        default y
        bool "Enable peformance for Hawkeye" if EXPERT
        depends on PRINTK
        help
           This operation anables monitor log mechanism for ZEUSIS private modules.

config HAWKEYE_EMS
        default y
        bool "Enable event for Hawkeye" if EXPERT
        depends on PRINTK
        help
           This operation anables monitor log mechanism for ZEUSIS private modules.

config HAWKEYE_DBG
        default y
        bool "Enable debug for Hawkeye" if EXPERT
        depends on PRINTK
        help
           This operation anables monitor log mechanism for ZEUSIS private modules.

config HAWKEYE_HP
        default n
        bool "Enable high performace for Hawkeye" if EXPERT
        depends on PRINTK
        help
           This operation anables monitor log mechanism for ZEUSIS private modules.  

endmenu
```

## drivers/blackshark/hawkeyecore/Kconfig
```kconfig
menu "zeusis linux device driver support"

#
# Hawkeye driver configuration
#
config HAWKEYE_CORE
        default y
        bool "Enable bug report for Hawkeye" if EXPERT
        depends on PRINTK
        help
           This operation anables monitor log mechanism for ZEUSIS private modules. 

endmenu
```

## drivers/devdetect/Kconfig
```kconfig
#
# detect devices
#

config HW_DEV_DCT
    default y
    bool "DEVICE DETECT"
    help
        Say yes if you want i2c device detect driver.
        This is for i2c connected version. If unsure, say N here.
```

## drivers/misc/oeminfo/Kconfig
```kconfig
#
# oeminfo drivers
#

config OEMINFO
	bool "oeminfo_driver.c"
	default n
	help
	  Say Y here to enable oeminfo driver.
```

## drivers/shark_util/Kconfig
```kconfig
config SHARK_POWER_DEBUG
        bool "Enable SHARK POWER DEBUG"
        ---help---
          Allows to enable power debug feature
```

## drivers/soc/qcom/vs_memshare/Kconfig
```kconfig
config VS_MEM_SHARE
       depends on MSM_QMI_INTERFACE
       bool "Shared Heap for VS"
       help
		Memory Share Kernel Qualcomm Messaging Interface Service
		receives requests from Modem Processor Sub System
		for heap alloc/free from Application Processor
		Sub System and send a response back to client with
		proper handle/address.
```

## drivers/staging/product_config/Kconfig
```kconfig
menuconfig PRODUCT_CFG
	bool "Enable Product Config feature"
	default n
	help
	  PRODUCT_CFG only enabled by config_config.sh to indicate that
	  product specific kernel configs have been enabled.

if PRODUCT_CFG
config BS_DEBUG
	bool "Blackshark debug feature"
	help
	  CONFIG_BS_DEBUG will be enabled in eng version, but disabled in user version.
	  You can use CONFIG_BS_DEBUG to print more debug message without impact
	  release version.
endif
```
