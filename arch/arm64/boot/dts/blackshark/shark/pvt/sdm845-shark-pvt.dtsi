/*
 * Copyright (c) 2015-2016, The Linux Foundation. All rights reserved.
 *
 * This program is free software; you can redistribute it and/or modify
 * it under the terms of the GNU General Public License version 2 and
 * only version 2 as published by the Free Software Foundation.
 *
 * This program is distributed in the hope that it will be useful,
 * but WITHOUT ANY WARRANTY; without even the implied warranty of
 * MERCHANTABILITY or FITNESS FOR A PARTICULAR PURPOSE.  See the
 * GNU General Public License for more details.
 */

#include "../dvt2/sdm845-shark-dvt2.dtsi"
#include "sdm845-pinctrl-shark-pvt.dtsi"



&dsi_synaptics_td4310_cmd_tianma {
		qcom,esd-check-enabled;
};

&pmi8998_charger {
	shark,board-is-dvt2 = <0>;
};
