
qcom,shark_sunwoda_4000mah {
	/* #3330414_Blackshark_G66lwn_4000mAh_averaged_MasterSlave_Mar7th2018*/
	qcom,max-voltage-uv = <4400000>;
	qcom,fg-cc-cv-threshold-mv = <4390>;
	qcom,fastchg-current-ma = <4000>;
	qcom,nom-batt-capacity-mah = <4000>;
	qcom,batt-id-kohm = <68>;
	qcom,battery-type = "shark_sunwoda_4000mah";
	qcom,jeita-fcc-ranges = <0      100     800000
	                         101    150     2000000
	                         151    450     4000000
	                         451    550     2800000>;
	qcom,jeita-fv-ranges  = <0      150     4400000
	                         151    450     4400000
	                         451    550     4100000>;
	qcom,jeita-fcc-ranges-aging = <(-200) 100     500000
                                   101    150     1000000
                                   151    450     4000000
                                   451    600     2000000
                                   601    680     500000>;
	qcom,jeita-fv-ranges-aging  = <(-200) 150     4400000
                                   151    450     4400000
                                   451    680     4100000>;
	qcom,battery-beta = <3380>;
	qcom,checksum = <0x8BD5>;
	qcom,gui-version = "PMI8998GUI - 2.0.0.58";
	qcom,fg-profile-data = [
		 1E 1F 26 06
		 07 0A C8 06
		 D9 1C F3 FB
		 BB 0D 9B 0A
		 29 17 12 2A
		 35 44 60 5A
		 72 00 00 00
		 11 00 00 00
		 00 00 92 BC
		 05 CD 79 CA
		 27 00 08 00
		 35 DB DD ED
		 F0 05 AB FA
		 AE 0D 23 0A
		 25 E4 09 2A
		 36 06 09 20
		 27 00 14 00
		 2A 20 17 05
		 D5 0A FC 05
		 CD 1C D5 02
		 4D 0C F2 0B
		 82 18 9D 23
		 4F 44 9C 5A
		 70 00 00 00
		 0F 00 00 00
		 00 00 CB D5
		 8D CA 7C AB
		 1E 00 00 00
		 7B EB DD ED
		 CD 06 91 F2
		 9F F4 BF FB
		 5D F3 50 1B
		 B7 33 CC FF
		 07 10 00 00
		 BF 0F 66 46
		 1E 00 40 00
		 3C 01 0A FA
		 FF 00 00 00
		 00 00 00 00
		 00 00 00 00
		 00 00 00 00
		 00 00 00 00
		 00 00 00 00
		 00 00 00 00
		 00 00 00 00
		 00 00 00 00
		 00 00 00 00
		 00 00 00 00
		 00 00 00 00
		 00 00 00 00
		 00 00 00 00
		 00 00 00 00
		 00 00 00 00
		 00 00 00 00
		 00 00 00 00
		 00 00 00 00
	];
};
