
qcom,shark_atl_4000mah {
	/* #3238965_Xiaomi_E30_ATL_4000mAH_averaged_MasterSlave_Jan2nd2018*/
	qcom,max-voltage-uv = <4400000>;
	qcom,fg-cc-cv-threshold-mv = <4390>;
	qcom,fastchg-current-ma = <4000>;
	qcom,nom-batt-capacity-mah = <4000>;
	qcom,batt-id-kohm = <10>;
	qcom,battery-type = "shark_atl_4000mah";
	qcom,jeita-fcc-ranges = <0      100     800000
	                         101    150     2000000
	                         151    450     4000000
	                         451    550     2800000>;
	qcom,jeita-fv-ranges  = <0      150     4400000
	                         151    450     4400000
	                         451    550     4100000>;
	qcom,jeita-fcc-ranges-aging = <(-200) 100     500000
                                   101    150     1000000
                                   151    450     4000000
                                   451    600     2000000
                                   601    680     500000>;
	qcom,jeita-fv-ranges-aging  = <(-200) 150     4400000
                                   151    450     4400000
                                   451    680     4100000>;
	qcom,battery-beta = <3380>;
	qcom,checksum = <0x37FD>;
	qcom,gui-version = "PMI8998GUI - 2.0.0.58";
	qcom,fg-profile-data = [
		 39 1F 09 06
		 1A 0A BA 06
		 DD 1C F1 FB
		 B8 0D 9E 0A
		 68 17 1C 2A
		 F2 4D BC 5A
		 73 00 00 00
		 10 00 00 00
		 00 00 D7 CC
		 B9 C5 16 CB
		 1E 00 08 00
		 EC BA 41 E5
		 25 F4 31 F2
		 13 FB 43 12
		 B6 05 99 2B
		 19 06 09 20
		 27 00 14 00
		 DA 1F 69 05
		 9C 0A 61 FC
		 C1 1C FF 02
		 F3 15 3D 12
		 74 18 BF 23
		 0B 44 E5 5A
		 6A 00 00 00
		 0E 00 00 00
		 00 00 F6 D5
		 03 CA 69 BA
		 1B 00 00 00
		 B4 EA 41 E5
		 42 07 64 00
		 54 EC 49 FB
		 29 DB 22 1B
		 B7 33 CC FF
		 07 10 00 00
		 E6 0F 66 46
		 1B 00 40 00
		 22 01 0A FA
		 FF 00 00 00
		 00 00 00 00
		 00 00 00 00
		 00 00 00 00
		 00 00 00 00
		 00 00 00 00
		 00 00 00 00
		 00 00 00 00
		 00 00 00 00
		 00 00 00 00
		 00 00 00 00
		 00 00 00 00
		 00 00 00 00
		 00 00 00 00
		 00 00 00 00
		 00 00 00 00
		 00 00 00 00
		 00 00 00 00
		 00 00 00 00
	];
};
