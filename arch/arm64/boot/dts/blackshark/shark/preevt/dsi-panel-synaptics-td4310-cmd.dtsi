/* Copyright (c) 2016-2017, The Linux Foundation. All rights reserved.
 *
 * This program is free software; you can redistribute it and/or modify
 * it under the terms of the GNU General Public License version 2 and
 * only version 2 as published by the Free Software Foundation.
 *
 * This program is distributed in the hope that it will be useful,
 * but WITHOUT ANY WARRANTY; without even the implied warranty of
 * MERCHANTABILITY or FITNESS FOR A PARTICULAR PURPOSE.  See the
 * GNU General Public License for more details.
 */

&mdss_mdp {
	dsi_synaptics_td4310_cmd_tianma: qcom,mdss_dsi_td4310_cmd_tianma {
		qcom,mdss-dsi-panel-name =
			"dsi synaptic td4310 cmd tianma";
		qcom,mdss-dsi-panel-controller = <&mdss_dsi0>;
		qcom,mdss-dsi-panel-type = "dsi_cmd_mode";
		qcom,mdss-dsi-panel-destination = "display_1";
		qcom,mdss-dsi-virtual-channel-id = <0>;
		qcom,mdss-dsi-stream = <0>;
		//qcom,mdss-dsi-panel-hdr-enabled;
		qcom,mdss-dsi-panel-hdr-color-primaries = <14500 15500 32000
			17000 15500 30000 8000 3000>;
		qcom,mdss-dsi-panel-peak-brightness = <4200000>;
		qcom,mdss-dsi-panel-blackness-level = <3230>;
		qcom,mdss-dsi-traffic-mode = "non_burst_sync_event";
		qcom,mdss-dsi-bllp-eof-power-mode;
		qcom,mdss-dsi-bllp-power-mode;
		qcom,mdss-dsi-lane-0-state;
		qcom,mdss-dsi-lane-1-state;
		qcom,mdss-dsi-lane-2-state;
		qcom,mdss-dsi-lane-3-state;
		/*qcom,cmd-sync-wait-broadcast;*/
		qcom,mdss-dsi-dma-trigger = "trigger_sw";
		qcom,mdss-dsi-mdp-trigger = "none";
		qcom,mdss-dsi-reset-sequence = <1 1>, <0 1>, <1 10>;
		qcom,mdss-pan-physical-width-dimension = <74>;
		qcom,mdss-pan-physical-height-dimension = <131>;
		/*qcom,mdss-dsi-tx-eot-append;*/
		qcom,mdss-dsi-underflow-color = <0x3ff>;
		qcom,mdss-dsi-border-color = <0>;
		qcom,mdss-dsi-bpp = <24>;
		qcom,mdss-dsi-te-pin-select = <1>;
		qcom,mdss-dsi-te-dcs-command = <1>;
		qcom,mdss-dsi-te-check-enable;
		qcom,mdss-dsi-te-using-te-pin;

		qcom,mdss-dsi-display-timings {
			timing@0{
				qcom,mdss-dsi-panel-width = <1080>;
				qcom,mdss-dsi-panel-height = <2160>;
				qcom,mdss-dsi-h-front-porch = <100>;
				qcom,mdss-dsi-h-back-porch = <80>;
				qcom,mdss-dsi-h-pulse-width = <20>;
				qcom,mdss-dsi-h-sync-skew = <0>;
				qcom,mdss-dsi-v-back-porch = <24>;
				qcom,mdss-dsi-v-front-porch = <4>;
				qcom,mdss-dsi-v-pulse-width = <2>;
				qcom,mdss-dsi-panel-framerate = <60>;
				qcom,mdss-dsi-on-lcd-refresh-direction = [
					15 01 00 00 00 00 02 36 03
				];
				qcom,mdss-dsi-on-lcd-refresh-direction-state = "dsi_lp_mode";
				qcom,mdss-dsi-on-command = [
					15 01 00 00 00 00 02 ff 10

					15 01 00 00 00 00 02 51 ff
					15 01 00 00 00 00 02 53 2c
					15 01 00 00 00 00 02 55 00
					15 01 00 00 00 00 02 ff 10
					15 01 00 00 00 00 02 35 00
					05 01 00 00 00 00 02 11 00
					];
				qcom,mdss-dsi-off-command = [
				05 01 00 00 32 00 02 28 00
				05 01 00 00 78 00 02 10 00];
				qcom,mdss-dsi-on-command-state = "dsi_lp_mode";
				qcom,mdss-dsi-off-command-state = "dsi_hs_mode";
				qcom,mdss-dsi-h-sync-pulse = <0>;
			};
		};
	};
};

