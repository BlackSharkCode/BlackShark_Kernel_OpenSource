/*
 * Copyright (c) 2015-2016, The Linux Foundation. All rights reserved.
 *
 * This program is free software; you can redistribute it and/or modify
 * it under the terms of the GNU General Public License version 2 and
 * only version 2 as published by the Free Software Foundation.
 *
 * This program is distributed in the hope that it will be useful,
 * but WITHOUT ANY WARRANTY; without even the implied warranty of
 * MERCHANTABILITY or FITNESS FOR A PARTICULAR PURPOSE.  See the
 * GNU General Public License for more details.
 */

/dts-v1/;

#include "qcom/sdm845.dtsi"
#include "qcom/sdm845-sde-display.dtsi"
#include "qcom/sdm845-mtp.dtsi"
#include "qcom/sdm845-audio-overlay.dtsi"
#include "sdm845-shark-preevt.dtsi"

/ {
	model = "Blackshark Technologies, Inc. SDM845 v1 MTP. Shark PreEVT";
	compatible = "qcom,sdm845-mtp", "qcom,sdm845", "qcom,mtp";
	qcom,board-id = <8 8>;
	blackshark,board-id = <0x22>;
	/* qcom,pmic-id = <0x0001001b 0x0101011a 0x0 0x0>, */
	/* 		<0x0001001b 0x0201011a 0x0 0x0>; */
};

