/*
 * Copyright (c) 2015-2016, The Linux Foundation. All rights reserved.
 *
 * This program is free software; you can redistribute it and/or modify
 * it under the terms of the GNU General Public License version 2 and
 * only version 2 as published by the Free Software Foundation.
 *
 * This program is distributed in the hope that it will be useful,
 * but WITHOUT ANY WARRANTY; without even the implied warranty of
 * MERCHANTABILITY or FITNESS FOR A PARTICULAR PURPOSE.  See the
 * GNU General Public License for more details.
 */

#include "../preevt/sdm845-shark-preevt.dtsi"
#include "sdm845-pinctrl-shark-evt.dtsi"
#include "sdm845-camera-sensor-shark-evt.dtsi"

&soc {
	slide_button {
		compatible = "slide_button";

		pinctrl-names = "default";
		pinctrl-0 = <&slide_button_default>;

		slide-button,gpios = <&tlmm 119 0>;
		debounce-interval = <15>;
		slide-button,wakeup;
	};
};

/*
  device check : the 0 means that it don't need to check;
    the 1 means that it check at board level and phone level test(running test);
    the 2 means that it only check at phone level test(running test);
*/

&devcheck {
	status = "ok";
	camera_main = <2>;
	camera_rearaux = <2>;
	camera_slave = <2>;
	charge_master = <1>;
	charge_slave = <2>;
	rgb = <1>;
};
